## meta-nodejs-native-bin/conf/layer.conf
```bitbake
# Layer configuration for meta-nodejs-native-bin
BBPATH .= ":${LAYERDIR}"

# Add recipes-* directories to BBFILES
BBFILES += "${LAYERDIR}/recipes-*/*/*.bb \
            ${LAYERDIR}/recipes-*/*/*.bbappend"

BBFILE_COLLECTIONS += "nodejs-native-bin"
BBFILE_PATTERN_nodejs-native-bin = "^${LAYERDIR}/"
BBFILE_PRIORITY_nodejs-native-bin = "10"

LAYERDEPENDS_nodejs-native-bin = "core"
LAYERSERIES_COMPAT_nodejs-native-bin = "whinlatter"
```

## meta-rauc-web-ui/conf/layer.conf
```bitbake
# We have a conf and classes directory, add to BBPATH
BBPATH .= ":${LAYERDIR}"

# We have recipes-* directories, add to BBFILES
BBFILES += "${LAYERDIR}/recipes-*/*/*.bb \
            ${LAYERDIR}/recipes-*/*/*.bbappend"

BBFILE_COLLECTIONS += "rauc-web-ui"
BBFILE_PATTERN_rauc-web-ui = "^${LAYERDIR}/"
BBFILE_PRIORITY_rauc-web-ui = "10"

LAYERDEPENDS_rauc-web-ui = "core"
LAYERSERIES_COMPAT_rauc-web-ui = "whinlatter"
```
